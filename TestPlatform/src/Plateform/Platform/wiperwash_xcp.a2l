ASAP2_VERSION 1 71
/begin PROJECT WipeWash_BCM ""
/begin HEADER "WipeWash BCM Calibration Parameters" VERSION "1.0.0" PROJECT_NO BCM_WIPEWASH /end HEADER
/begin MODULE BCM ""
/begin MOD_COMMON "" BYTE_ORDER MSB_LAST ALIGNMENT_BYTE 1 ALIGNMENT_WORD 2 ALIGNMENT_LONG 4 ALIGNMENT_FLOAT32_IEEE 4 ALIGNMENT_FLOAT64_IEEE 8 /end MOD_COMMON
/begin RECORD_LAYOUT FLOAT32_SCALAR FNC_VALUES 1 FLOAT32_IEEE ROW_DIR DIRECT /end RECORD_LAYOUT
/begin RECORD_LAYOUT SWORD_SCALAR FNC_VALUES 1 SWORD ROW_DIR DIRECT /end RECORD_LAYOUT
/begin RECORD_LAYOUT UWORD_SCALAR FNC_VALUES 1 UWORD ROW_DIR DIRECT /end RECORD_LAYOUT
/* ─── Timing fonctionnel ─────────────────────────────────── */
/begin CHARACTERISTIC TOUCH_DURATION "Durée max cycle TOUCH (SRD_WW_020)" VALUE 0x00000001 FLOAT32_SCALAR 0 CONV_IDENTITY 0.500 3.000 /begin EXTENDED_LIMITS 0.500 3.000 /end EXTENDED_LIMITS STEP_SIZE 0.100 PHYS_UNIT "s"
 /begin ANNOTATION ANNOTATION_LABEL "default" ANNOTATION_ORIGIN "BCM" /begin ANNOTATION_TEXT "1.700" /end ANNOTATION_TEXT /end ANNOTATION
 /begin ANNOTATION ANNOTATION_LABEL "category" ANNOTATION_ORIGIN "BCM" /begin ANNOTATION_TEXT "TIMING" /end ANNOTATION_TEXT /end ANNOTATION
/end CHARACTERISTIC
/begin CHARACTERISTIC PARK_TIMEOUT "Timeout retour parking après ignition OFF (FSR_004)" VALUE 0x00000002 FLOAT32_SCALAR 0 CONV_IDENTITY 1.000 10.000 /begin EXTENDED_LIMITS 1.000 10.000 /end EXTENDED_LIMITS STEP_SIZE 0.500 PHYS_UNIT "s"
 /begin ANNOTATION ANNOTATION_LABEL "default" ANNOTATION_ORIGIN "BCM" /begin ANNOTATION_TEXT "5.000" /end ANNOTATION_TEXT /end ANNOTATION
 /begin ANNOTATION ANNOTATION_LABEL "category" ANNOTATION_ORIGIN "BCM" /begin ANNOTATION_TEXT "TIMING" /end ANNOTATION_TEXT /end ANNOTATION
/end CHARACTERISTIC
/begin CHARACTERISTIC REVERSE_REAR_PERIOD "Période cycle essuie-glace arrière (REAR_WIPE)" VALUE 0x00000003 FLOAT32_SCALAR 0 CONV_IDENTITY 0.500 3.000 /begin EXTENDED_LIMITS 0.500 3.000 /end EXTENDED_LIMITS STEP_SIZE 0.100 PHYS_UNIT "s"
 /begin ANNOTATION ANNOTATION_LABEL "default" ANNOTATION_ORIGIN "BCM" /begin ANNOTATION_TEXT "1.700" /end ANNOTATION_TEXT /end ANNOTATION
 /begin ANNOTATION ANNOTATION_LABEL "category" ANNOTATION_ORIGIN "BCM" /begin ANNOTATION_TEXT "TIMING" /end ANNOTATION_TEXT /end ANNOTATION
/end CHARACTERISTIC
/begin CHARACTERISTIC WIPE_CYCLE_DURATION "Durée cycle balayage (alias TOUCH_DURATION)" VALUE 0x00000004 FLOAT32_SCALAR 0 CONV_IDENTITY 0.500 3.000 /begin EXTENDED_LIMITS 0.500 3.000 /end EXTENDED_LIMITS STEP_SIZE 0.100 PHYS_UNIT "s"
 /begin ANNOTATION ANNOTATION_LABEL "default" ANNOTATION_ORIGIN "BCM" /begin ANNOTATION_TEXT "1.700" /end ANNOTATION_TEXT /end ANNOTATION
 /begin ANNOTATION ANNOTATION_LABEL "category" ANNOTATION_ORIGIN "BCM" /begin ANNOTATION_TEXT "TIMING" /end ANNOTATION_TEXT /end ANNOTATION
/end CHARACTERISTIC
/* ─── Pompe ──────────────────────────────────────────────── */
/begin CHARACTERISTIC PUMP_MAX_RUNTIME "Durée max pompe active (FSR_005)" VALUE 0x00000010 FLOAT32_SCALAR 0 CONV_IDENTITY 2.000 10.000 /begin EXTENDED_LIMITS 2.000 10.000 /end EXTENDED_LIMITS STEP_SIZE 0.500 PHYS_UNIT "s"
 /begin ANNOTATION ANNOTATION_LABEL "default" ANNOTATION_ORIGIN "BCM" /begin ANNOTATION_TEXT "5.000" /end ANNOTATION_TEXT /end ANNOTATION
 /begin ANNOTATION ANNOTATION_LABEL "category" ANNOTATION_ORIGIN "BCM" /begin ANNOTATION_TEXT "PUMP" /end ANNOTATION_TEXT /end ANNOTATION
/end CHARACTERISTIC
/* ─── Cycles lavage ──────────────────────────────────────── */
/begin CHARACTERISTIC WASH_FRONT_CYCLES "Cycles min lavage avant" VALUE 0x00000020 SWORD_SCALAR 0 CONV_IDENTITY 1 8 /begin EXTENDED_LIMITS 1 8 /end EXTENDED_LIMITS STEP_SIZE 1 PHYS_UNIT "cycles"
 /begin ANNOTATION ANNOTATION_LABEL "default" ANNOTATION_ORIGIN "BCM" /begin ANNOTATION_TEXT "3" /end ANNOTATION_TEXT /end ANNOTATION
 /begin ANNOTATION ANNOTATION_LABEL "category" ANNOTATION_ORIGIN "BCM" /begin ANNOTATION_TEXT "WASH" /end ANNOTATION_TEXT /end ANNOTATION
/end CHARACTERISTIC
/begin CHARACTERISTIC WASH_REAR_CYCLES "Cycles min lavage arrière" VALUE 0x00000021 SWORD_SCALAR 0 CONV_IDENTITY 1 6 /begin EXTENDED_LIMITS 1 6 /end EXTENDED_LIMITS STEP_SIZE 1 PHYS_UNIT "cycles"
 /begin ANNOTATION ANNOTATION_LABEL "default" ANNOTATION_ORIGIN "BCM" /begin ANNOTATION_TEXT "2" /end ANNOTATION_TEXT /end ANNOTATION
 /begin ANNOTATION ANNOTATION_LABEL "category" ANNOTATION_ORIGIN "BCM" /begin ANNOTATION_TEXT "WASH" /end ANNOTATION_TEXT /end ANNOTATION
/end CHARACTERISTIC
/* ─── Capteur pluie ──────────────────────────────────────── */
/begin CHARACTERISTIC RAIN_SPEED2_THRESH "Seuil intensité pluie -> passage Speed2 (mode AUTO)" VALUE 0x00000030 SWORD_SCALAR 0 CONV_IDENTITY 5 80 /begin EXTENDED_LIMITS 5 80 /end EXTENDED_LIMITS STEP_SIZE 5 PHYS_UNIT "%"
 /begin ANNOTATION ANNOTATION_LABEL "default" ANNOTATION_ORIGIN "BCM" /begin ANNOTATION_TEXT "20" /end ANNOTATION_TEXT /end ANNOTATION
 /begin ANNOTATION ANNOTATION_LABEL "category" ANNOTATION_ORIGIN "BCM" /begin ANNOTATION_TEXT "RAIN" /end ANNOTATION_TEXT /end ANNOTATION
/end CHARACTERISTIC
/* ─── Protection courant moteur ──────────────────────────── */
/begin CHARACTERISTIC OVERCURRENT_THRESH "Seuil surintensité moteur avant/arrière (B2001/B2002)" VALUE 0x00000040 FLOAT32_SCALAR 0 CONV_IDENTITY 0.200 1.000 /begin EXTENDED_LIMITS 0.200 1.000 /end EXTENDED_LIMITS STEP_SIZE 0.050 PHYS_UNIT "A"
 /begin ANNOTATION ANNOTATION_LABEL "default" ANNOTATION_ORIGIN "BCM" /begin ANNOTATION_TEXT "0.8" /end ANNOTATION_TEXT /end ANNOTATION
 /begin ANNOTATION ANNOTATION_LABEL "category" ANNOTATION_ORIGIN "BCM" /begin ANNOTATION_TEXT "PROTECTION" /end ANNOTATION_TEXT /end ANNOTATION
/end CHARACTERISTIC
/begin CHARACTERISTIC OVERCURRENT_DELAY "Délai maintien surcourant avant DTC moteur" VALUE 0x00000041 FLOAT32_SCALAR 0 CONV_IDENTITY 0.050 1.000 /begin EXTENDED_LIMITS 0.050 1.000 /end EXTENDED_LIMITS STEP_SIZE 0.050 PHYS_UNIT "s"
 /begin ANNOTATION ANNOTATION_LABEL "default" ANNOTATION_ORIGIN "BCM" /begin ANNOTATION_TEXT "0.300" /end ANNOTATION_TEXT /end ANNOTATION
 /begin ANNOTATION ANNOTATION_LABEL "category" ANNOTATION_ORIGIN "BCM" /begin ANNOTATION_TEXT "PROTECTION" /end ANNOTATION_TEXT /end ANNOTATION
/end CHARACTERISTIC
/* ─── Protection courant pompe ───────────────────────────── */
/begin CHARACTERISTIC PUMP_OVERCURRENT_THRESH "Seuil surintensité pompe (B2003)" VALUE 0x00000050 FLOAT32_SCALAR 0 CONV_IDENTITY 0.200 1.000 /begin EXTENDED_LIMITS 0.200 1.000 /end EXTENDED_LIMITS STEP_SIZE 0.050 PHYS_UNIT "A"
 /begin ANNOTATION ANNOTATION_LABEL "default" ANNOTATION_ORIGIN "BCM" /begin ANNOTATION_TEXT "0.8" /end ANNOTATION_TEXT /end ANNOTATION
 /begin ANNOTATION ANNOTATION_LABEL "category" ANNOTATION_ORIGIN "BCM" /begin ANNOTATION_TEXT "PROTECTION" /end ANNOTATION_TEXT /end ANNOTATION
/end CHARACTERISTIC
/begin CHARACTERISTIC PUMP_OVERCURRENT_DELAY "Délai maintien surcourant avant DTC pompe" VALUE 0x00000051 FLOAT32_SCALAR 0 CONV_IDENTITY 0.050 1.000 /begin EXTENDED_LIMITS 0.050 1.000 /end EXTENDED_LIMITS STEP_SIZE 0.050 PHYS_UNIT "s"
 /begin ANNOTATION ANNOTATION_LABEL "default" ANNOTATION_ORIGIN "BCM" /begin ANNOTATION_TEXT "0.300" /end ANNOTATION_TEXT /end ANNOTATION
 /begin ANNOTATION ANNOTATION_LABEL "category" ANNOTATION_ORIGIN "BCM" /begin ANNOTATION_TEXT "PROTECTION" /end ANNOTATION_TEXT /end ANNOTATION
/end CHARACTERISTIC
/* ─── Contact repos ──────────────────────────────────────── */
/begin CHARACTERISTIC REST_STUCK_DELAY "Délai lame bloquée avant DTC B2009" VALUE 0x00000060 FLOAT32_SCALAR 0 CONV_IDENTITY 1.000 10.000 /begin EXTENDED_LIMITS 1.000 10.000 /end EXTENDED_LIMITS STEP_SIZE 0.500 PHYS_UNIT "s"
 /begin ANNOTATION ANNOTATION_LABEL "default" ANNOTATION_ORIGIN "BCM" /begin ANNOTATION_TEXT "3.0" /end ANNOTATION_TEXT /end ANNOTATION
 /begin ANNOTATION ANNOTATION_LABEL "category" ANNOTATION_ORIGIN "BCM" /begin ANNOTATION_TEXT "PROTECTION" /end ANNOTATION_TEXT /end ANNOTATION
/end CHARACTERISTIC
/* ─── Watchdog ───────────────────────────────────────────── */
/begin CHARACTERISTIC WATCHDOG_MAX_MS "Seuil timeout watchdog T-WSM (FSR_008)" VALUE 0x00000070 UWORD_SCALAR 0 CONV_IDENTITY 100 2000 /begin EXTENDED_LIMITS 100 2000 /end EXTENDED_LIMITS STEP_SIZE 50 PHYS_UNIT "ms"
 /begin ANNOTATION ANNOTATION_LABEL "default" ANNOTATION_ORIGIN "BCM" /begin ANNOTATION_TEXT "500" /end ANNOTATION_TEXT /end ANNOTATION
 /begin ANNOTATION ANNOTATION_LABEL "category" ANNOTATION_ORIGIN "BCM" /begin ANNOTATION_TEXT "WATCHDOG" /end ANNOTATION_TEXT /end ANNOTATION
/end CHARACTERISTIC
/* ─── Conversion identité (pas de facteur/offset) ────────── */
/begin COMPU_METHOD CONV_IDENTITY "Identity conversion - no scaling" RAT_FUNC "%6.3" "" /begin COEFFS 0 1 0 0 0 1 /end COEFFS /end COMPU_METHOD
/end MODULE
/end PROJECT
